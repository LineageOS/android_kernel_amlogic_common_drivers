## arch/arm64/configs/sabrina_defconfig
```kconfig
# Thermal
CONFIG_THERMAL_DEFAULT_GOV_STEP_WISE=y
CONFIG_THERMAL_GOV_STEP_WISE=y
# CONFIG_THERMAL_DEFAULT_GOV_POWER_ALLOCATOR is not set
# CONFIG_THERMAL_GOV_POWER_ALLOCATOR is not set

# Board thermistors
CONFIG_HWMON=m
CONFIG_SENSORS_NTC_THERMISTOR=m

# Status LEDs
CONFIG_LEDS_PWM=m

# USB-C power input
CONFIG_GOOGLE_TYPEC_TCPM=m
CONFIG_GOOGLE_TYPEC_TCPCI=m
CONFIG_GOOGLE_TYPEC_RT1711H=m
CONFIG_GOOGLE_USB_POWER_MONITOR=m

# BL40
CONFIG_AMLOGIC_FIRMWARE=m
```

## drivers/google/Kconfig
```kconfig
# SPDX-License-Identifier: GPL-2.0

menu "Google device drivers"

source "$(COMMON_DRIVERS_DIR)/drivers/google/usb/Kconfig"

config GOOGLE_USB_POWER_MONITOR
	tristate "Google USB power monitor"
	depends on HWMON
	depends on POWER_SUPPLY
	depends on THERMAL_OF
	depends on GPIOLIB
	help
	  Reports the power available from the USB supply, through hwmon and
	  as a thermal sensor.

endmenu
```

## drivers/google/usb/Kconfig
```kconfig
# SPDX-License-Identifier: GPL-2.0

source "$(COMMON_DRIVERS_DIR)/drivers/google/usb/typec/Kconfig"
```

## drivers/google/usb/typec/Kconfig
```kconfig
# SPDX-License-Identifier: GPL-2.0

if TYPEC

source "$(COMMON_DRIVERS_DIR)/drivers/google/usb/typec/tcpm/Kconfig"

endif # TYPEC
```

## drivers/google/usb/typec/tcpm/Kconfig
```kconfig
# SPDX-License-Identifier: GPL-2.0

config GOOGLE_TYPEC_TCPM
	tristate "USB Type-C Port Controller Manager"
	depends on USB
	select USB_ROLE_SWITCH
	select POWER_SUPPLY
	help
	  The Type-C Port Controller Manager provides a USB PD and USB Type-C
	  state machine for use with Type-C Port Controllers.

if GOOGLE_TYPEC_TCPM

config GOOGLE_TYPEC_TCPCI
	tristate "Type-C Port Controller Interface driver"
	depends on I2C
	select REGMAP_I2C
	help
	  Type-C Port Controller driver for TCPCI-compliant controller.

if GOOGLE_TYPEC_TCPCI

config GOOGLE_TYPEC_RT1711H
	tristate "Richtek RT1711H Type-C chip driver"
	help
	  Richtek RT1711H Type-C chip driver that works with
	  Type-C Port Controller Manager to provide USB PD and USB
	  Type-C functionalities.

endif # GOOGLE_TYPEC_TCPCI

endif # GOOGLE_TYPEC_TCPM
```

## drivers/misc/Kconfig
```kconfig
# SPDX-License-Identifier: GPL-2.0-only

config KHADAS_MCU
	tristate "Khadas MCU"
	default n
	help
	  This driver is for Khadas MCU.
	  Control fan && WoL, and the power for CPU
```
